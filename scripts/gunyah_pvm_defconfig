## scripts/gunyah_pvm_defconfig
```kconfig
BR2_ARCH_IS_64=y
BR2_aarch64=y
BR2_ARCH_HAS_TOOLCHAIN_BUILDROOT=y
# BR2_ARCH="aarch64"
# BR2_ENDIAN="LITTLE"
# BR2_ARM_CPU_HAS_FPU=y
# BR2_ARM_CPU_HAS_VFPV2=y
# BR2_ARM_CPU_HAS_VFPV3=y
# BR2_ARM_CPU_HAS_VFPV4=y
# BR2_ARM_CPU_HAS_FP_ARMV8=y
# BR2_ARM_CPU_ARMV8A=y

BR2_cortex_a53=y

BR2_TOOLCHAIN=y
BR2_TOOLCHAIN_USES_GLIBC=y
BR2_TOOLCHAIN_BUILDROOT=y
BR2_TOOLCHAIN_BUILDROOT_GLIBC=y
BR2_TOOLCHAIN_BUILDROOT_LIBC="glibc"

BR2_PACKAGE_GLIBC=y
BR2_PACKAGE_LIBCAP=y

BR2_INIT_BUSYBOX=y

BR2_TARGET_ROOTFS_EXT2=y
BR2_TARGET_ROOTFS_EXT2_4=y
BR2_TARGET_ROOTFS_EXT2_GEN=4
```
